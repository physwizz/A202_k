## arch/arm64/Kconfig.exynos
```kconfig
config MACH_EXYNOS7885_A20_GLOBAL
	bool "Build DTBO img for A20"
	depends on SOC_EXYNOS7885
	default n
	help
	Say Y here if you want to enable building dtbo for galaxy A20.
```
